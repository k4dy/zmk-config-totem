## config/boards/shields/settings_reset/Kconfig.shield
```kconfig
config SHIELD_SETTINGS_RESET
    def_bool $(shields_list_contains,settings_reset)
```

## config/boards/shields/totem/Kconfig.defconfig
```kconfig
# Copyright (c) 2022 The ZMK Contributors
# SPDX-License-Identifier: MIT

if SHIELD_TOTEM_LEFT

config ZMK_KEYBOARD_NAME
    default "TOTEM"

# Removed ZMK_SPLIT_ROLE_CENTRAL - dongle is now central

endif

if SHIELD_TOTEM_LEFT || SHIELD_TOTEM_RIGHT

config ZMK_SPLIT
    default y

endif
```

## config/boards/shields/totem_dongle/Kconfig.shield
```kconfig
# Copyright (c) 2025 The ZMK Contributors
# SPDX-License-Identifier: MIT

config SHIELD_TOTEM_DONGLE
    def_bool $(shields_list_contains,totem_dongle)
```
